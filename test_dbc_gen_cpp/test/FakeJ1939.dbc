VERSION "Fake J1939 DBC for testing"

NS_ :

BS_:

BU_: ECU1 ECU2

BO_ 2364539904 EngineData: 8 ECU1
 SG_ engine_rpm : 0|16@1+ (1,0) [0|65535] "rpm" ECU2
 SG_ engine_load : 16|8@1+ (1,0) [0|255] "%" ECU2

BO_ 2566844672 VehicleSpeed: 8 ECU1
 SG_ speed : 0|16@1+ (1,0) [0|65535] "km/h" ECU2

BO_ 2563440384 TorqueCommand: 8 ECU2
 SG_ torque_request : 0|8@1+ (1,0) [0|255] "%" ECU1

BO_ 2361921573 BrakeCommand: 8 ECU2
 SG_ brake_pressure : 0|16@1+ (0.1,0) [0|6553.5] "bar" ECU1
 SG_ brake_mode : 16|8@1+ (1,0) [0|255] "" ECU1

BO_ 2147484647 EmptyJ1939Message: 0 ECU2

BO_ 300 BatteryStatus: 4 ECU1
 SG_ battery_voltage : 0|16@1+ (0.01,0) [0|655.35] "V" ECU2
 SG_ battery_soc : 16|8@1+ (0.5,0) [0|100] "%" ECU2

BA_DEF_ BO_ "VFrameFormat" ENUM "StandardCAN","ExtendedCAN","reserved","J1939PG";
BA_DEF_ "ProtocolType" STRING ;
BA_DEF_DEF_ "VFrameFormat" "";
BA_DEF_DEF_ "ProtocolType" "";
BA_ "ProtocolType" "J1939";
BA_ "VFrameFormat" BO_ 2364539904 3;
BA_ "VFrameFormat" BO_ 2566844672 3;
BA_ "VFrameFormat" BO_ 2563440384 3;
BA_ "VFrameFormat" BO_ 2361921573 3;
BA_ "VFrameFormat" BO_ 2147484647 3;

CM_ BO_ 300 "Add one non-J1939 Message to test having a single non-J1939 message in a J1939 DBC";
