VERSION "A fake vehicle CAN profile for testing"

NS_ :

BS_:

BU_: Vehicle Computer

BO_ 1 Heartbeat: 1 Computer
  SG_ alive : 0|1@1+ (1,0) [0|1] "bool" Vehicle

BO_ 2 ReadyForAutonomy: 1 Vehicle
  SG_ ready : 0|1@1+ (1,0) [0|1] "bool" Computer

BO_ 100 SpeedFeedback: 4 Vehicle
 SG_ speed : 0|32@1- (1,0) [0|0] "m/s" Computer

BO_ 101 SteeringFeedback: 1 Vehicle
  SG_ angle : 0|8@1- (1,0) [0|180] "degrees" Computer

BO_ 200 DriveCommand: 8 Computer
 SG_ drive_speed : 0|32@1- (1,0) [0|0] "m/s" Vehicle
 SG_ drive_angle : 32|32@1- (1,0) [0|0] "rad/s" Vehicle

BO_ 201 Fuel_Tank_Level: 2 Computer
  SG_ fuel_tank_level : 0|16@1+ (0.0015258789,0) [0|100] "%" Vehicle

BO_ 999 EmptyMessage: 0 Computer

BO_ 2147483848 ExtendedDiagnostic: 8 Computer
 SG_ diagnostic_code : 0|16@1+ (1,0) [0|65535] "" Vehicle
 SG_ fault_count : 16|8@1+ (1,0) [0|255] "" Vehicle

BO_ 2566859520 EngineAuxStatus: 8 Vehicle
 SG_ aux_coolant_temp : 0|8@1+ (1,-40) [-40|210] "degC" Computer
 SG_ aux_oil_pressure : 8|8@1+ (4,0) [0|1000] "kPa" Computer

BO_ 102 GearStatus: 1 Vehicle
 SG_ gear : 0|8@1+ (1,0) [0|255] "" Computer

BO_ 103 DriveModeStatus: 1 Vehicle
 SG_ mode : 0|8@1+ (1,0) [0|255] "" Computer

BO_ 104 MotorStatus: 1 Vehicle
 SG_ direction : 0|8@1- (1,0) [-1|1] "" Computer

BO_ 105 SensorFlags: 4 Vehicle
 SG_ flags : 0|32@1- (1,0) [0|0] "" Computer

BA_DEF_ BO_ "VFrameFormat" ENUM "StandardCAN","ExtendedCAN","reserved","J1939PG";
BA_DEF_DEF_ "VFrameFormat" "";
BA_ "VFrameFormat" BO_ 2566859520 3;

SIG_VALTYPE_ 100 speed : 1;
SIG_VALTYPE_ 200 drive_speed : 1;
SIG_VALTYPE_ 200 drive_angle : 1;
SIG_VALTYPE_ 105 flags : 1;

CM_ BO_ 2147483848 "CAN ID 200 (0xC8) with extended frame flag (0x80000000) set";
CM_ BO_ 2566859520 "Add one J1939 Message to test having a single J1939 message in a non-J1939 DBC";

VAL_ 102 gear 0 "Neutral" 1 "Drive" 2 "Reverse" 3 "Reserved" 4 "Reserved" 5 "4wd mode" 6 "Park!" ;
VAL_ 103 mode 0 "Off" 1 "On" ;
VAL_ 104 direction -1 "Reverse" 0 "Stopped" 1 "Forward" ;
VAL_ 105 flags 1 "Enabled" 2 "Fault" 2147483648 "Calibrating" ;

BA_DEF_ SG_ "SystemSignalLongSymbol" STRING ;
BA_DEF_DEF_ "SystemSignalLongSymbol" "";
BA_ "SystemSignalLongSymbol" SG_ 103 mode "Drive Mode Select";
